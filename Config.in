## Config.in
```kconfig
menu "Build option"
comment "Set build configuration"
config ECL_CC
	string "Cross compiler path"
	default "/usr/bin/gcc"
config ECL_CFLAGS
	string "Cross compiler flags"
	default "-Wall -Werror"
config ECL_LD
	string "Linker path"
	default "/usr/bin/gcc"
config ECL_LDFLAGS
	string "Linker flags"
	default "-L."
config ECL_LIBS
	string "Libraries to link with"
	help
		Library parameters to pass to CC ex: -lpthread
config ECL_AR
	string "Archiver path"
	default "/usr/bin/ar"
config ECL_ARFLAGS
	string "Archiver flags"
	default ""
config ECL_STATIC
	bool "Compile static library"
	default n
config ECL_TEST
	bool "Compile test executable binary"
	default n
endmenu

source system/Config.in

source src/Config.in
```

## src/network/Config.in
```kconfig
menu "Network features"
source src/network/tcp/Config.in
source src/network/config/Config.in
endmenu
```

## src/network/config/Config.in
```kconfig
config ECL_SRC_NETWORK_CONFIG
	bool "Configure network interfaces"

config ECL_SRC_NETWORK_CONFIG_SETIP
	bool "add function to change ip address"
	depends on ECL_SRC_NETWORK_CONFIG
	default n

config ECL_SRC_NETWORK_CONFIG_NETIFACE
	bool "Get information on network interfaces"
	depends on ECL_SRC_NETWORK_CONFIG
	default n
```

## src/network/tcp/Config.in
```kconfig
config ECL_SRC_NETWORK_TCP
	bool "Basic tcp/ip client and server

config ECL_SRC_NETWORK_TCP_CLIENT
	bool "add tcp client function"
	depends on ECL_SRC_NETWORK_TCP
	default n

config ECL_SRC_NETWORK_TCP_SERVER
	bool "add tcp server function"
	depends on ECL_SRC_NETWORK_TCP
	default n
```

## system/Config.in
```kconfig
menu "System configuration"
comment "Set system configuration"

choice
	prompt "Logging mechanism"
	default ECL_SYS_LOG_PRINTF
config ECL_SYS_LOG_PRINTF
	bool "printf"
config ECL_SYS_LOG_ZLOG
	bool "zlog"
endchoice

config ECL_SYS_BASE_STRUCT
	bool "Implements basic structure"
	default n

config ECL_SYS_BASE_STRUCT_FIFO
	bool "Enable FIFO"
	depends on ECL_SYS_BASE_STRUCT
	default n

config ECL_SYS_BASE_STRUCT_LIFO
	bool "Enable LIFO"
	depends on ECL_SYS_BASE_STRUCT
	default n

config ECL_SYS_BASE_THREAD
	bool "Enable multi threading"
	default y

config ECL_SYS_BASE_WAIT
	bool "inter thread wait and signal"
	default n

endmenu
```
